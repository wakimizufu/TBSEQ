//
//    FILE: FRAM11_test.ino
//  AUTHOR: Rob Tillaart
// PURPOSE: demo FRAM11 memory test
//     URL: https://github.com/RobTillaart/FRAM_I2C


#include "FRAM.h"

FRAM11 fram;

uint32_t start;
uint32_t stop;

uint32_t sizeInBytes = 0;




	/*
		/*
	パターン情報 ビットストリーム
	☆総バイト数  :0x00FF=256Byte
		0x0000:sequenceMap開始
			0x0000:パターン1
			0x0020:パターン2
			0x0040:パターン3
			0x0060:パターン4
			0x0080:パターン5
			0x00A0:パターン6
			0x00C0:パターン7
			0x00E0:パターン8

		0x0000:パターン
			0x0000:ステップ1
			0x0002:ステップ2
			0x0004:ステップ3
			0x0006:ステップ4
			0x0008:ステップ5
			0x000A:ステップ6
			0x000C:ステップ7
			0x000E:ステップ8
			0x0010:ステップ9
			0x0012:ステップ10
			0x0014:ステップ11
			0x0016:ステップ12
			0x0018:ステップ13
			0x001A:ステップ14
			0x001C:ステップ15
			0x001E:ステップ16

		[ステップ]
		1Byte:
			bit7-5:(未使用:全て0)
			bit  4:最終ステップ(最終ステップ:1,通常ステップ:0)
			bit  3:スライド(オン:1,オフ:0)
			bit  2:アクセント(オン:1,オフ:0)
			bit  1:オクターブDown(オン:1,オフ:0)
			bit  0:オクターブUp(オン:1,オフ:0)

		1Byte:
			bit7-6:(未使用:全て0)
			bit5-4:ノートオンオフ 1:ノートオン/2:ノートオン(タイ)/0:ノートオフ
			bit3-0:ノート(NOTE_PWM_INDEX::NOTE_C2～NOTE_PWM_INDEX::NOTE_C3⇒0x0～0xD を設定)
	*/
	#define SEQUENCE_ALLBYTE 256

	uint8_t patern_preset_bitstream[SEQUENCE_ALLBYTE]{
	0x00,0x10, 0x00,0x10, 0x00,0x12, 0x00,0x13, 0x00,0x14, 0x00,0x15, 0x00,0x16, 0x00,0x17, 0x00,0x18, 0x00,0x19, 0x00,0x1A, 0x00,0x1B, 0x00,0x1C, 0x00,0x1D, 0x00,0x1C, 0x10,0x1B,	//パターン1
	0x01,0x10, 0x01,0x21, 0x01,0x12, 0x01,0x13, 0x01,0x14, 0x01,0x15, 0x01,0x16, 0x01,0x17, 0x01,0x28, 0x01,0x29, 0x01,0x1A, 0x01,0x2B, 0x01,0x1C, 0x01,0x1D, 0x01,0x1C, 0x11,0x1B,	//パターン2
	0x02,0x10, 0x02,0x11, 0x02,0x12, 0x02,0x13, 0x02,0x14, 0x02,0x15, 0x02,0x16, 0x02,0x17, 0x02,0x18, 0x02,0x19, 0x02,0x1A, 0x02,0x1B, 0x02,0x1C, 0x02,0x1D, 0x02,0x1C, 0x12,0x1B,	//パターン3
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	0x00,0x20, 0x00,0x21, 0x00,0x02, 0x00,0x23, 0x00,0x24, 0x00,0x05, 0x00,0x26, 0x00,0x07, 0x00,0x28, 0x00,0x29, 0x00,0x2A, 0x00,0x0B, 0x00,0x2C, 0x00,0x2D, 0x00,0x2C, 0x10,0x2B	//パターン8
	};


//sequenceMap:バンク全数
	#define SEQUENCE_BANK_LENGTH 4


void setup()
{
   delay(2000);

  Serial.begin(115200);
  Serial.println(__FILE__);
  Serial.print("FRAM_LIB_VERSION: ");
  Serial.println(FRAM_LIB_VERSION);

  Wire.begin();

  int rv = fram.begin(0x50);

  Serial.print("rv:\t");
  Serial.println(rv);

  if (rv != 0)
  {
    Serial.print("INIT ERROR: ");
    Serial.println(rv);
  }

  //  get size
  Serial.print("   KB  :\t");
  Serial.println(fram.getSize());
  Serial.print("BYTES  :\t");
  Serial.println(fram.getSizeBytes());
  sizeInBytes = fram.getSizeBytes();


  delay(100);

  test();

  Serial.println("done...");
}


void loop()
{
}


void test()
{
  //  addr goes from 0 .. 2047
  //  value goes from 0.. 255

  // シークエンスマップ:1バンク当たり256Byte * 4バンク=1024Byte (0x000～03FF)

  uint8_t value = 0x00;
  uint32_t bank, pattern, addr;

	for ( bank=0 ; bank < SEQUENCE_BANK_LENGTH; bank++){
	  for (pattern = 0; pattern < SEQUENCE_ALLBYTE; pattern++)
	  {
			value	=	patern_preset_bitstream[pattern];
			addr	=	(bank*SEQUENCE_ALLBYTE) + pattern;

		  fram.write8(addr, value);
	    Serial.print("sequenceMap::Write\t");
	    Serial.print(addr,HEX);
	    Serial.print("\t");
	    Serial.println(value,HEX);
	    delay(10);
	  }
	}


  // read back
	for ( bank=0 ; bank < SEQUENCE_BANK_LENGTH; bank++){
	  for (pattern = 0; pattern < SEQUENCE_ALLBYTE; pattern++)
	  {
			addr	=	(bank*SEQUENCE_ALLBYTE) + pattern;
	    value = fram.read8(addr);

	    Serial.print("sequenceMap::Read\t");
	    Serial.print(addr,HEX);
	    Serial.print("\t");
	    Serial.println(value,HEX);
	    delay(10);
	  }
	}

}

//  -- END OF FILE --
